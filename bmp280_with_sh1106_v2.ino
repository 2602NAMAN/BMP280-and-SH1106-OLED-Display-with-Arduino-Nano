#include <Wire.h>
#include <Adafruit_Sensor.h>
#include <Adafruit_BMP280.h>
#include <U8glib.h>

// Create BMP280 object
Adafruit_BMP280 bmp; 

// Create U8GLIB object for SH1106
U8GLIB_SH1106_128X64 u8g(U8G_I2C_OPT_NONE);

// Temperture logo for splashscreen
const uint8_t temp_logo[] U8G_PROGMEM = {
  0x00, 0x00, 0x00, 0x00, 0x00, 0x00, 0x00, 0x00, 0x00, 0x00, 0x00, 0x00, 0x00, 0x00, 0x00, 0x00, 
	0x00, 0x3c, 0x00, 0x00, 0x00, 0x00, 0x46, 0x00, 0x00, 0x00, 0x00, 0x82, 0x00, 0x00, 0x00, 0x00, 
	0x82, 0x00, 0x00, 0x00, 0x00, 0x82, 0x00, 0x00, 0x00, 0x00, 0x82, 0xe0, 0x00, 0x00, 0x00, 0x82, 
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	0x00, 0x00, 0x00, 0x00, 0x00, 0x00, 0x00, 0x00
};

// Pressure logo for splashscreen
const uint8_t pres_logo[] U8G_PROGMEM = {
	0x00, 0x00, 0x00, 0x00, 0x00, 0x00, 0x00, 0x7e, 0x00, 0x00, 0x00, 0x03, 0xff, 0xc0, 0x00, 0x00, 
	0x1f, 0x81, 0xf8, 0x00, 0x00, 0x38, 0x00, 0x1c, 0x00, 0x00, 0xf1, 0x99, 0x8f, 0x00, 0x01, 0xc8, 
	0x99, 0x13, 0x80, 0x03, 0x88, 0x99, 0x11, 0xc0, 0x07, 0x04, 0x18, 0x20, 0xe0, 0x06, 0x46, 0x00, 
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	0x7e, 0x00, 0x00, 0x00, 0x00, 0x00, 0x00, 0x00
};

// Altitude logo for splashscreen
const uint8_t alt_logo[] U8G_PROGMEM = {
	0x00, 0x00, 0x00, 0x00, 0x00, 0x00, 0x00, 0x00, 0x00, 0x00, 0x00, 0x00, 0x00, 0x00, 0x00, 0x00, 
	0x00, 0x00, 0x00, 0x00, 0x00, 0x00, 0x00, 0x00, 0x00, 0x00, 0x00, 0x00, 0x00, 0x00, 0x00, 0x00, 
	0x00, 0x00, 0x00, 0x00, 0x01, 0x00, 0x00, 0x00, 0x00, 0x03, 0x80, 0x00, 0x00, 0x00, 0x03, 0x80, 
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	0x00, 0x00, 0x00, 0x00, 0x00, 0x00, 0x00, 0x00
};

//Splashscreen
void displaySplashScreen() 
{
  // Show splashscreen for 3 seconds
  u8g.firstPage();
  do {
    // Draw logo bitmap at (48, 16)
    u8g.drawBitmapP(2, 12, 40/8, 40, temp_logo);
    u8g.drawBitmapP(42, 12, 40/8, 40, pres_logo);
    u8g.drawBitmapP(84, 12, 40/8, 40, alt_logo);

    u8g.setContrast(255); // Set the display brightness (0-255)

  } while (u8g.nextPage());

  delay(2000);
}

void setup() 
{
  // Initialize serial communication
  Serial.begin(9600);

  // Initialize BMP280 sensor
  if (!bmp.begin(0x76)) 
  {
    Serial.println("Could not find a valid BMP280 sensor, check wiring!");
    while (1);
  } 
  else 
  {
    Serial.println("BMP280 sensor initialized successfully.");
  }

  // Initialize OLED display
  Serial.println("OLED display initialized successfully.");
  u8g.setContrast(255); // Set the display brightness (0-255)

  // Display splash screen
  displaySplashScreen();

  // Default settings from datasheet
  bmp.setSampling(Adafruit_BMP280::MODE_NORMAL,     // Operating Mode
                  Adafruit_BMP280::SAMPLING_X2,     // Temp. oversampling
                  Adafruit_BMP280::SAMPLING_X16,    // Pressure oversampling
                  Adafruit_BMP280::FILTER_X16,      // Filtering
                  Adafruit_BMP280::STANDBY_MS_500); // Standby time
}

void loop() 
{
  Serial.print(F("Temperature = "));
  Serial.print(bmp.readTemperature());
  Serial.println(" °C");

  Serial.print(F("Pressure = "));
  Serial.print(bmp.readPressure()/100);
  Serial.println(" hPa");

  Serial.print(F("Altitude = "));
  Serial.print(bmp.readAltitude(1013.25)); // Adjusted to local forecast!
  Serial.println(" m");

  // Convert float to string for display
  char temperatureStr[10];
  dtostrf(bmp.readTemperature(), 6, 2, temperatureStr);

  char pressureStr[10];
  dtostrf(bmp.readPressure()/100, 6, 2, pressureStr);

  char altitudeStr[10];
  dtostrf(bmp.readAltitude(1013.25), 6, 2, altitudeStr);

  // Display values on OLED
  u8g.firstPage();
  do {
    u8g.setFont(u8g_font_profont12r); // font for heading
    u8g.drawStr(0, 10, "BMP280 Sensor Data:");
    u8g.drawLine(0, 12, 106, 12); // Draw a line under the heading
    
    // font for the data
    u8g.setFont(u8g_font_profont11); 

    // Display Temperature
    u8g.drawStr(0, 28, "Temperature:");
    u8g.drawStr(69, 28, temperatureStr);
    u8g.drawStr(107, 28, "\xB0""C");
    
    // Display Pressure
    u8g.drawStr(0, 40, "Pressure:");
    u8g.drawStr(57, 40, pressureStr);
    u8g.drawStr(95, 40, "hPa");
    
    // Display Altitude
    u8g.drawStr(0, 52, "Altitude:");
    u8g.drawStr(57, 52, altitudeStr);
    u8g.drawStr(95, 52, "m");

  } while (u8g.nextPage());

  // Delay before next reading
  delay(1000);
}